## CMakeLists.txt
```
# Live AF screening: MAX30102 -> signal processing -> quality gate -> int8 model.
cmake_minimum_required(VERSION 3.20.0)

# Always send console output over USB (same as passing -S cdc-acm-console)
set(SNIPPET cdc-acm-console CACHE STRING "")

find_package(Zephyr REQUIRED HINTS $ENV{ZEPHYR_BASE})
project(af_live LANGUAGES C CXX)

target_sources(app PRIVATE
	src/main.cpp
	src/sensor.c
	src/max30102.c
	src/af_session.c
	src/af_dsp.c
)
target_include_directories(app PRIVATE src)
```

## prj.conf
```kconfig
# --- Sensor: I2C bus and the interrupt pin ---
CONFIG_I2C=y
CONFIG_GPIO=y

# --- C++ and the C library TFLite Micro needs ---
CONFIG_CPP=y
CONFIG_STD_CPP17=y
CONFIG_REQUIRES_FULL_LIBC=y

# --- TensorFlow Lite Micro, with Arm's optimized CMSIS-NN kernels ---
CONFIG_TENSORFLOW_LITE_MICRO=y
CONFIG_TENSORFLOW_LITE_MICRO_CMSIS_NN_KERNELS=y

# --- Hardware floating point (Cortex-M4F) ---
CONFIG_FPU=y

# --- Cycle-accurate timing for the per-window processing time ---
CONFIG_TIMING_FUNCTIONS=y

# --- Let printk print floats ---
CONFIG_CBPRINTF_FP_SUPPORT=y

# --- Processing runs in main(); lower priority than the sensor thread (2) ---
CONFIG_MAIN_THREAD_PRIORITY=7
CONFIG_MAIN_STACK_SIZE=4096
```

## src/main.cpp
```c
/*
 * Live AF screening on the Arduino Nano 33 BLE Sense.
 *
 * Place a finger on the MAX30102. Once contact has settled, the board
 * analyses each 30 s of pulse on its own and reports:
 *   normal / possible AF / unreliable signal
 * together with heart rate and signal quality. Nothing runs on the PC except
 * a serial terminal to read the output.
 */

#include <zephyr/kernel.h>
#include <zephyr/sys/printk.h>
#include <zephyr/timing/timing.h>

#include <math.h>

#include <tensorflow/lite/micro/micro_interpreter.h>
#include <tensorflow/lite/micro/micro_mutable_op_resolver.h>
#include <tensorflow/lite/schema/schema_generated.h>

#include "af_dsp.h"
#include "af_model.h"
#include "af_session.h"
#include "sensor.h"

namespace {

constexpr size_t kArenaSize = 4 * 1024;
alignas(16) uint8_t tensor_arena[kArenaSize];

tflite::MicroInterpreter *interpreter;
TfLiteTensor *model_in;
TfLiteTensor *model_out;

struct af_session session;

bool model_init()
{
	const tflite::Model *model = tflite::GetModel(af_model);

	if (model->version() != TFLITE_SCHEMA_VERSION) {
		printk("Model schema mismatch\n");
		return false;
	}
	static tflite::MicroMutableOpResolver<4> resolver;

	resolver.AddFullyConnected();
	resolver.AddLogistic();
	resolver.AddSub();
	resolver.AddMul();

	static tflite::MicroInterpreter interp(model, resolver, tensor_arena, kArenaSize);

	if (interp.AllocateTensors() != kTfLiteOk) {
		printk("AllocateTensors failed\n");
		return false;
	}
	interpreter = &interp;
	model_in = interp.input(0);
	model_out = interp.output(0);
	return true;
}

/* Returns the model's AF probability; *raw gets the int8 output (AF if >= 0). */
float run_model(const float features[AF_NUM_FEATURES], int8_t *raw)
{
	const float scale = model_in->params.scale;
	const int zp = model_in->params.zero_point;

	for (int f = 0; f < AF_NUM_FEATURES; f++) {
		int32_t q = static_cast<int32_t>(lroundf(features[f] / scale)) + zp;

		model_in->data.int8[f] = static_cast<int8_t>(q < -128 ? -128 : (q > 127 ? 127 : q));
	}
	interpreter->Invoke();
	*raw = model_out->data.int8[0];
	return (*raw - model_out->params.zero_point) * model_out->params.scale;
}

void print_time()
{
	int64_t s = k_uptime_get() / 1000;

	printk("[%02d:%02d] ", (int)(s / 60), (int)(s % 60));
}

}  // namespace

int main(void)
{
	k_sleep(K_SECONDS(2));
	printk("\n=== Live AF screening on %s ===\n", CONFIG_BOARD_TARGET);

	if (!model_init()) {
		return -1;
	}
	while (sensor_status() != 0) {
		printk("MAX30102 not found (error %d): check wiring and power\n", sensor_status());
		k_sleep(K_SECONDS(1));
	}

	print_time();
	printk("Sensor ready. Place your finger lightly on the sensor.\n");

	timing_init();
	timing_start();
	af_session_reset(&session);

	int window = 0;
	uint32_t last_overflows = 0;

	while (true) {
		int32_t ir;

		if (sensor_get(&ir, K_SECONDS(1)) != 0) {
			continue;
		}

		struct af_window_result r;
		timing_t t0 = timing_counter_get();
		enum af_event event = af_session_push(&session, ir, &r);

		switch (event) {
		case AF_EVENT_FINGER_DETECTED:
			print_time();
			printk("Finger detected, hold still...\n");
			break;

		case AF_EVENT_MEASURING:
			window = 0;
			print_time();
			printk("Measuring. First result in about 32 s.\n");
			break;

		case AF_EVENT_FINGER_LIFTED:
			print_time();
			printk("Finger lifted. Place your finger to start again.\n");
			break;

		case AF_EVENT_WINDOW_DONE: {
			int8_t raw = -128;
			float p_af = 0.0f;

			if (r.features_valid) {
				p_af = run_model(r.features, &raw);
			}
			timing_t t1 = timing_counter_get();
			uint32_t us = (uint32_t)(timing_cycles_to_ns(timing_cycles_get(&t0, &t1)) / 1000);

			print_time();
			if (!r.passes_gate) {
				printk("Window %d: unreliable signal (SQI %.2f, %d beats). Keep still, "
				       "light touch.\n", window, (double)r.sqi, r.n_beats);
			} else {
				printk("Window %d: %s | HR %.0f bpm | SQI %.2f | p(AF) %.2f | %u us\n",
				       window, raw >= 0 ? "POSSIBLE AF" : "normal",
				       (double)r.heart_rate_bpm, (double)r.sqi, (double)p_af, us);
			}
			window++;

			struct sensor_stats st;

			sensor_get_stats(&st);
			if (st.fifo_overflows != last_overflows || st.queue_drops != 0) {
				printk("    warning: samples lost (fifo %u, queue %u, i2c errors %u)\n",
				       st.fifo_overflows, st.queue_drops, st.i2c_errors);
				last_overflows = st.fifo_overflows;
			}
			break;
		}
		default:
			break;
		}
	}
	return 0;
}
```

## src/af_dsp.c
```c
#include "af_dsp.h"

#include <math.h>
#include <stdlib.h>
#include <string.h>

/*
 * Band-pass filter: scipy.signal.butter(2, (0.5, 8.0), btype="bandpass",
 * fs=100, output="sos"). Two second-order sections: b0 b1 b2 a1 a2 (a0 = 1).
 */
static const float sos[2][5] = {
	{ 4.1253537242e-02f, 8.2507074483e-02f, 4.1253537242e-02f,
	  -1.3658733440e+00f, 5.3692604607e-01f },
	{ 1.0000000000e+00f, -2.0000000000e+00f, 1.0000000000e+00f,
	  -1.9561871344e+00f, 9.5726757526e-01f },
};

#define PEAK_DISTANCE   33      /* 0.33 s at 100 Hz */
#define PEAK_PROMINENCE 0.5f
#define MIN_BEATS       15
#define IBI_MIN_MS      300.0f
#define IBI_MAX_MS      2000.0f
#define PNN_FRACTION    0.065f

/* Scratch buffers (static: too large for a thread stack) */
static float norm_win[AF_WIN_SAMPLES];
static float template_buf[AF_WIN_SAMPLES];
static int peak_buf[AF_MAX_PEAKS];
static int order_buf[AF_MAX_PEAKS];
static uint8_t keep_buf[AF_MAX_PEAKS];
static float ibi_buf[AF_MAX_PEAKS];
static float diff_buf[AF_MAX_PEAKS];
static int int_buf[AF_MAX_PEAKS];

/* ------------------------------------------------------------------ */
/* Filter: transposed direct form II, the same structure as sosfilt   */

static float filter_step(float z[2][2], float x)
{
	for (int s = 0; s < 2; s++) {
		const float *c = sos[s];
		float y = c[0] * x + z[s][0];

		z[s][0] = c[1] * x - c[3] * y + z[s][1];
		z[s][1] = c[2] * x - c[4] * y;
		x = y;
	}
	return x;
}

/* ------------------------------------------------------------------ */
/* Beat detection: scipy.signal.find_peaks(x, distance=33, prominence=0.5) */

static const float *sort_values;

static int cmp_by_value(const void *a, const void *b)
{
	float va = sort_values[*(const int *)a];
	float vb = sort_values[*(const int *)b];

	if (va < vb) {
		return -1;
	}
	if (va > vb) {
		return 1;
	}
	return (*(const int *)a) - (*(const int *)b);
}

int af_find_peaks(const float *x, int n, int *peaks)
{
	int m = 0;

	/* 1) Local maxima, including the midpoint of flat-topped peaks
	 *    (scipy _local_maxima_1d). */
	for (int i = 1; i < n - 1; i++) {
		if (x[i - 1] < x[i]) {
			int ahead = i + 1;

			while (ahead < n - 1 && x[ahead] == x[i]) {
				ahead++;
			}
			if (x[ahead] < x[i]) {
				if (m < AF_MAX_PEAKS) {
					peak_buf[m++] = (i + ahead - 1) / 2;
				}
				i = ahead;
			}
		}
	}

	/* 2) Minimum distance: keep the tallest peaks first and remove any
	 *    neighbour closer than PEAK_DISTANCE (scipy _select_by_peak_distance). */
	static float heights[AF_MAX_PEAKS];

	for (int i = 0; i < m; i++) {
		order_buf[i] = i;
		keep_buf[i] = 1;
		heights[i] = x[peak_buf[i]];
	}
	sort_values = heights;
	qsort(order_buf, m, sizeof(int), cmp_by_value);

	for (int i = m - 1; i >= 0; i--) {
		int j = order_buf[i];

		if (!keep_buf[j]) {
			continue;
		}
		for (int k = j - 1; k >= 0 && peak_buf[j] - peak_buf[k] < PEAK_DISTANCE; k--) {
			keep_buf[k] = 0;
		}
		for (int k = j + 1; k < m && peak_buf[k] - peak_buf[j] < PEAK_DISTANCE; k++) {
			keep_buf[k] = 0;
		}
	}

	/* 3) Prominence: height above the higher of the two lowest points
	 *    reached before a taller sample on each side (scipy _peak_prominences). */
	int out = 0;

	for (int i = 0; i < m; i++) {
		if (!keep_buf[i]) {
			continue;
		}
		int p = peak_buf[i];
		float left_min = x[p];
		float right_min = x[p];

		for (int k = p; k >= 0 && x[k] <= x[p]; k--) {
			if (x[k] < left_min) {
				left_min = x[k];
			}
		}
		for (int k = p; k < n && x[k] <= x[p]; k++) {
			if (x[k] < right_min) {
				right_min = x[k];
			}
		}
		float prominence = x[p] - (left_min > right_min ? left_min : right_min);

		if (prominence >= PEAK_PROMINENCE) {
			peaks[out++] = p;
		}
	}
	return out;
}

/* ------------------------------------------------------------------ */
/* Medians (numpy semantics: mean of the two middle values when even)  */

static int cmp_int(const void *a, const void *b)
{
	return *(const int *)a - *(const int *)b;
}

static int cmp_float(const void *a, const void *b)
{
	float fa = *(const float *)a;
	float fb = *(const float *)b;

	return (fa > fb) - (fa < fb);
}

static float median_float(float *v, int n)
{
	qsort(v, n, sizeof(float), cmp_float);
	return (n % 2) ? v[n / 2] : 0.5f * (v[n / 2 - 1] + v[n / 2]);
}

/* ------------------------------------------------------------------ */
/* Quality gate: template-matching SQI                                 */

float af_template_sqi(const float *w, int n, const int *peaks, int n_peaks)
{
	if (n_peaks < 5) {
		return 0.0f;
	}

	/* half = int(0.5 * median(diff(peaks))), computed exactly in integers */
	int nd = n_peaks - 1;

	for (int i = 0; i < nd; i++) {
		int_buf[i] = peaks[i + 1] - peaks[i];
	}
	qsort(int_buf, nd, sizeof(int), cmp_int);
	int half = (nd % 2) ? int_buf[nd / 2] / 2 : (int_buf[nd / 2 - 1] + int_buf[nd / 2]) / 4;
	int len = 2 * half;

	/* Template = average of all complete beats, centred on each peak */
	int n_beats = 0;

	memset(template_buf, 0, sizeof(float) * len);
	for (int i = 0; i < n_peaks; i++) {
		int s = peaks[i] - half;

		if (s < 0 || peaks[i] + half > n) {
			continue;
		}
		for (int j = 0; j < len; j++) {
			template_buf[j] += w[s + j];
		}
		n_beats++;
	}
	if (n_beats < 5 || len == 0) {
		return 0.0f;
	}

	float t_mean = 0.0f;

	for (int j = 0; j < len; j++) {
		template_buf[j] /= (float)n_beats;
		t_mean += template_buf[j];
	}
	t_mean /= (float)len;

	float t_ss = 0.0f;

	for (int j = 0; j < len; j++) {
		float d = template_buf[j] - t_mean;

		t_ss += d * d;
	}

	/* Mean Pearson correlation of each beat with the template */
	float r_sum = 0.0f;

	for (int i = 0; i < n_peaks; i++) {
		int s = peaks[i] - half;

		if (s < 0 || peaks[i] + half > n) {
			continue;
		}
		float b_mean = 0.0f;

		for (int j = 0; j < len; j++) {
			b_mean += w[s + j];
		}
		b_mean /= (float)len;

		float cross = 0.0f;
		float b_ss = 0.0f;

		for (int j = 0; j < len; j++) {
			float db = w[s + j] - b_mean;

			cross += db * (template_buf[j] - t_mean);
			b_ss += db * db;
		}
		r_sum += cross / sqrtf(b_ss * t_ss);
	}
	return r_sum / (float)n_beats;
}

/* ------------------------------------------------------------------ */
/* Rhythm features from beat-to-beat intervals                         */

bool af_rhythm_features(const int *peaks, int n_peaks, float features[AF_NUM_FEATURES],
			float *heart_rate_bpm)
{
	if (n_peaks < MIN_BEATS) {
		return false;
	}

	int n_ibi = 0;

	for (int i = 0; i < n_peaks - 1; i++) {
		float ibi = (float)(peaks[i + 1] - peaks[i]) * (1000.0f / AF_FS);

		if (ibi > IBI_MIN_MS && ibi < IBI_MAX_MS) {
			ibi_buf[n_ibi++] = ibi;
		}
	}
	if (n_ibi < MIN_BEATS - 1) {
		return false;
	}

	float mean = 0.0f;

	for (int i = 0; i < n_ibi; i++) {
		mean += ibi_buf[i];
	}
	mean /= (float)n_ibi;

	float var = 0.0f;

	for (int i = 0; i < n_ibi; i++) {
		float d = ibi_buf[i] - mean;

		var += d * d;
	}
	var /= (float)n_ibi;

	int nd = n_ibi - 1;
	float sq_sum = 0.0f;
	int above = 0;

	for (int i = 0; i < nd; i++) {
		diff_buf[i] = fabsf(ibi_buf[i + 1] - ibi_buf[i]);
		sq_sum += diff_buf[i] * diff_buf[i];
		if (diff_buf[i] > PNN_FRACTION * mean) {
			above++;
		}
	}

	features[0] = sqrtf(sq_sum / (float)nd) / mean;      /* nrmssd */
	features[1] = sqrtf(var) / mean;                      /* cv */
	features[2] = (float)above / (float)nd;               /* pnn_rel */
	features[3] = median_float(diff_buf, nd) / mean;      /* mad_rel */
	*heart_rate_bpm = 60000.0f / mean;
	return true;
}

/* ------------------------------------------------------------------ */
/* One 30 s window: normalise, detect beats, quality gate, features    */

void af_analyse_window(float *w, struct af_window_result *out)
{
	float mean = 0.0f;

	for (int i = 0; i < AF_WIN_SAMPLES; i++) {
		mean += w[i];
	}
	mean /= (float)AF_WIN_SAMPLES;

	float var = 0.0f;

	for (int i = 0; i < AF_WIN_SAMPLES; i++) {
		float d = w[i] - mean;

		var += d * d;
	}
	float sd = sqrtf(var / (float)AF_WIN_SAMPLES);

	memset(out, 0, sizeof(*out));
	if (sd <= 1e-6f) {
		return;   /* flat signal: nothing to analyse */
	}
	for (int i = 0; i < AF_WIN_SAMPLES; i++) {
		w[i] = (w[i] - mean) / sd;
	}

	static int peaks[AF_MAX_PEAKS];

	out->n_beats = af_find_peaks(w, AF_WIN_SAMPLES, peaks);
	out->sqi = af_template_sqi(w, AF_WIN_SAMPLES, peaks, out->n_beats);
	out->features_valid = af_rhythm_features(peaks, out->n_beats, out->features,
						 &out->heart_rate_bpm);
	out->passes_gate = out->features_valid && out->sqi >= AF_SQI_THRESHOLD;
}

/* ------------------------------------------------------------------ */
/* Streaming pipeline                                                  */

void af_pipeline_reset(struct af_pipeline *p)
{
	memset(p, 0, sizeof(*p));
}

static bool feed_filtered(struct af_pipeline *p, float x, struct af_window_result *out)
{
	float y = filter_step(p->z, x - p->dc);

	if (p->skipped < AF_SKIP_SAMPLES) {
		p->skipped++;
		return false;
	}
	p->win[p->win_fill++] = y;
	if (p->win_fill < AF_WIN_SAMPLES) {
		return false;
	}
	p->win_fill = 0;
	memcpy(norm_win, p->win, sizeof(norm_win));
	af_analyse_window(norm_win, out);
	return true;
}

bool af_pipeline_push(struct af_pipeline *p, int32_t raw_ir, struct af_window_result *out)
{
	if (!p->dc_ready) {
		/* Collect the first second, then use its mean as the DC level */
		p->dc_buf[p->dc_fill++] = raw_ir;
		if (p->dc_fill < AF_DC_SAMPLES) {
			return false;
		}
		float sum = 0.0f;

		for (int i = 0; i < AF_DC_SAMPLES; i++) {
			sum += -(float)p->dc_buf[i];
		}
		p->dc = sum / (float)AF_DC_SAMPLES;
		p->dc_ready = true;

		/* The first second is part of the signal too: filter it now */
		bool done = false;

		for (int i = 0; i < AF_DC_SAMPLES; i++) {
			done |= feed_filtered(p, -(float)p->dc_buf[i], out);
		}
		return done;
	}
	return feed_filtered(p, -(float)raw_ir, out);
}
```

## src/af_session.c
```c
#include "af_session.h"

#include <string.h>

void af_session_reset(struct af_session *s)
{
	memset(s, 0, sizeof(*s));
	s->state = AF_STATE_WAITING;
}

enum af_event af_session_push(struct af_session *s, int32_t raw_ir,
			      struct af_window_result *result)
{
	const bool on = raw_ir > AF_CONTACT_LEVEL;

	switch (s->state) {
	case AF_STATE_WAITING:
		s->on_run = on ? s->on_run + 1 : 0;
		if (s->on_run == AF_CONTACT_CONFIRM) {
			/* The first "on" sample was AF_CONTACT_CONFIRM samples ago */
			s->since_first_on = AF_CONTACT_CONFIRM;
			s->off_run = 0;
			s->state = AF_STATE_SETTLING;
			return AF_EVENT_FINGER_DETECTED;
		}
		return AF_EVENT_NONE;

	case AF_STATE_SETTLING:
		s->off_run = on ? 0 : s->off_run + 1;
		if (s->off_run >= AF_LIFT_SAMPLES) {
			af_session_reset(s);
			return AF_EVENT_FINGER_LIFTED;
		}
		/* since_first_on counts samples including the first "on" one, so the
		 * sample at offset AF_SETTLE_SAMPLES is number AF_SETTLE_SAMPLES + 1 */
		if (++s->since_first_on <= AF_SETTLE_SAMPLES) {
			return AF_EVENT_NONE;
		}
		/* This sample is the first one analysed, as in the notebook */
		af_pipeline_reset(&s->pipeline);
		af_pipeline_push(&s->pipeline, raw_ir, result);
		s->state = AF_STATE_MEASURING;
		return AF_EVENT_MEASURING;

	case AF_STATE_MEASURING:
		s->off_run = on ? 0 : s->off_run + 1;
		if (s->off_run >= AF_LIFT_SAMPLES) {
			af_session_reset(s);
			return AF_EVENT_FINGER_LIFTED;
		}
		return af_pipeline_push(&s->pipeline, raw_ir, result) ? AF_EVENT_WINDOW_DONE
								      : AF_EVENT_NONE;
	}
	return AF_EVENT_NONE;
}
```

## src/af_session.h
```c
/*
 * Measurement session: decides when the finger is on the sensor and feeds
 * the AF pipeline only while it is.
 *
 * Same rule as the notebook:
 *   - finger "on" when IR > 50,000 counts (no finger reads ~8,000)
 *   - contact confirmed after 1 s continuously on
 *   - analysis starts 3 s after the first "on" sample (pressure settling)
 *   - finger "lifted" after 0.5 s continuously off; the session then restarts
 *
 * Plain C, no Zephyr dependencies, so it can be tested on a PC.
 */
#ifndef AF_SESSION_H_
#define AF_SESSION_H_

#include "af_dsp.h"

#ifdef __cplusplus
extern "C" {
#endif

#define AF_CONTACT_LEVEL   50000
#define AF_CONTACT_CONFIRM AF_FS              /* 1 s on before contact counts */
#define AF_SETTLE_SAMPLES  (3 * AF_FS)        /* analysis starts 3 s after first "on" */
#define AF_LIFT_SAMPLES    (AF_FS / 2)        /* 0.5 s off = finger lifted */

enum af_state {
	AF_STATE_WAITING,     /* no finger */
	AF_STATE_SETTLING,    /* finger detected, waiting for it to settle */
	AF_STATE_MEASURING,   /* feeding the pipeline */
};

enum af_event {
	AF_EVENT_NONE,
	AF_EVENT_FINGER_DETECTED,
	AF_EVENT_MEASURING,
	AF_EVENT_FINGER_LIFTED,
	AF_EVENT_WINDOW_DONE,   /* *result holds a completed 30 s window */
};

struct af_session {
	enum af_state state;
	int on_run;           /* consecutive samples above the contact level */
	int off_run;          /* consecutive samples below it */
	int since_first_on;   /* samples since the first "on" sample of this contact */
	struct af_pipeline pipeline;
};

void af_session_reset(struct af_session *s);

/* Feed one raw IR sample; returns what happened. */
enum af_event af_session_push(struct af_session *s, int32_t raw_ir,
			      struct af_window_result *result);

#ifdef __cplusplus
}
#endif

#endif /* AF_SESSION_H_ */
```

## src/max30102.c
```c
#include "max30102.h"

#include <zephyr/kernel.h>
#include <zephyr/sys/printk.h>

/* Register map (MAX30102 datasheet) */
#define REG_INT_STATUS_1   0x00
#define REG_INT_STATUS_2   0x01
#define REG_INT_ENABLE_1   0x02
#define REG_INT_ENABLE_2   0x03
#define REG_FIFO_WR_PTR    0x04
#define REG_OVF_COUNTER    0x05
#define REG_FIFO_RD_PTR    0x06
#define REG_FIFO_DATA      0x07
#define REG_FIFO_CONFIG    0x08
#define REG_MODE_CONFIG    0x09
#define REG_SPO2_CONFIG    0x0A
#define REG_LED1_PA        0x0C   /* red LED current */
#define REG_LED2_PA        0x0D   /* IR LED current */
#define REG_PART_ID        0xFF

#define PART_ID_MAX30102   0x15

/* MODE_CONFIG */
#define MODE_RESET         BIT(6)
#define MODE_SPO2          0x03   /* red + IR */

/* FIFO_CONFIG: SMP_AVE[7:5], FIFO_ROLLOVER_EN[4], FIFO_A_FULL[3:0] */
#define FIFO_SMP_AVE_4     (0x2 << 5)
#define FIFO_ROLLOVER_EN   BIT(4)
#define FIFO_A_FULL_17     0x0F   /* interrupt when 32 - 15 = 17 samples are waiting */

/* SPO2_CONFIG: ADC_RGE[6:5], SR[4:2], LED_PW[1:0] */
#define SPO2_ADC_4096NA    (0x1 << 5)
#define SPO2_SR_400HZ      (0x3 << 2)
#define SPO2_PW_411US      0x3

/* INT_ENABLE_1 */
#define INT_A_FULL_EN      BIT(7)

#define BYTES_PER_SAMPLE   6      /* 3 bytes red + 3 bytes IR */
#define SAMPLE_MASK        0x3FFFF /* 18-bit ADC */

static int write_reg(const struct i2c_dt_spec *i2c, uint8_t reg, uint8_t val)
{
	return i2c_reg_write_byte_dt(i2c, reg, val);
}

static int read_reg(const struct i2c_dt_spec *i2c, uint8_t reg, uint8_t *val)
{
	return i2c_reg_read_byte_dt(i2c, reg, val);
}

int max30102_init(const struct i2c_dt_spec *i2c, uint8_t led_current)
{
	uint8_t id;
	int ret = read_reg(i2c, REG_PART_ID, &id);

	if (ret) {
		return ret;                    /* no answer on I2C: wiring problem */
	}
	if (id != PART_ID_MAX30102) {
		printk("# MAX30102: unexpected part ID 0x%02x\n", id);
		return -ENODEV;
	}

	/* Software reset, then wait for the chip to clear the reset bit */
	ret = write_reg(i2c, REG_MODE_CONFIG, MODE_RESET);
	if (ret) {
		return ret;
	}
	for (int i = 0; i < 10; i++) {
		uint8_t mode;

		k_msleep(10);
		if (read_reg(i2c, REG_MODE_CONFIG, &mode) == 0 && !(mode & MODE_RESET)) {
			break;
		}
	}

	uint8_t dummy;
	read_reg(i2c, REG_INT_STATUS_1, &dummy);   /* clear power-ready flag */

	const uint8_t config[][2] = {
		{ REG_INT_ENABLE_1, INT_A_FULL_EN },
		{ REG_INT_ENABLE_2, 0x00 },
		{ REG_FIFO_WR_PTR,  0x00 },
		{ REG_OVF_COUNTER,  0x00 },
		{ REG_FIFO_RD_PTR,  0x00 },
		{ REG_FIFO_CONFIG,  FIFO_SMP_AVE_4 | FIFO_ROLLOVER_EN | FIFO_A_FULL_17 },
		{ REG_SPO2_CONFIG,  SPO2_ADC_4096NA | SPO2_SR_400HZ | SPO2_PW_411US },
		{ REG_LED1_PA,      led_current },
		{ REG_LED2_PA,      led_current },
		{ REG_MODE_CONFIG,  MODE_SPO2 },           /* starts sampling */
	};

	for (size_t i = 0; i < ARRAY_SIZE(config); i++) {
		ret = write_reg(i2c, config[i][0], config[i][1]);
		if (ret) {
			return ret;
		}
	}
	return 0;
}

int max30102_clear_interrupts(const struct i2c_dt_spec *i2c)
{
	uint8_t status[2];

	/* Reading both status registers clears them and releases INT */
	return i2c_burst_read_dt(i2c, REG_INT_STATUS_1, status, sizeof(status));
}

int max30102_read_fifo(const struct i2c_dt_spec *i2c,
		       struct max30102_sample *out, int max, int *overflow)
{
	uint8_t ptrs[3];   /* WR_PTR, OVF_COUNTER, RD_PTR are consecutive registers */
	int ret = i2c_burst_read_dt(i2c, REG_FIFO_WR_PTR, ptrs, sizeof(ptrs));

	if (ret) {
		return ret;
	}

	*overflow = ptrs[1];
	int count = (ptrs[0] - ptrs[2]) & (MAX30102_FIFO_DEPTH - 1);

	if (count == 0 && ptrs[1] != 0) {
		count = MAX30102_FIFO_DEPTH;   /* FIFO completely full after overflow */
	}
	if (count > max) {
		count = max;
	}
	if (count == 0) {
		return 0;
	}

	/* One burst read: the FIFO_DATA register does not auto-increment,
	 * so the chip streams consecutive samples from the same address. */
	uint8_t raw[MAX30102_FIFO_DEPTH * BYTES_PER_SAMPLE];

	ret = i2c_burst_read_dt(i2c, REG_FIFO_DATA, raw, count * BYTES_PER_SAMPLE);
	if (ret) {
		return ret;
	}

	for (int i = 0; i < count; i++) {
		const uint8_t *p = &raw[i * BYTES_PER_SAMPLE];

		out[i].red = ((uint32_t)p[0] << 16 | (uint32_t)p[1] << 8 | p[2]) & SAMPLE_MASK;
		out[i].ir  = ((uint32_t)p[3] << 16 | (uint32_t)p[4] << 8 | p[5]) & SAMPLE_MASK;
	}
	return count;
}
```

## src/max30102.h
```c
/*
 * Minimal MAX30102 driver on Zephyr's I2C API.
 *
 * Configuration (matches the Python pipeline):
 *   SpO2 mode (red + IR LEDs), 400 Hz internal sampling,
 *   4-sample averaging in the FIFO -> 100 Hz output,
 *   411 us LED pulses (18-bit ADC resolution), 4096 nA ADC range.
 */
#pragma once

#include <stdint.h>
#include <zephyr/drivers/i2c.h>

struct max30102_sample {
	uint32_t red;   /* 18-bit raw counts */
	uint32_t ir;    /* 18-bit raw counts; the AF pipeline uses this channel */
};

#define MAX30102_FIFO_DEPTH 32

/* Check the part ID, reset the chip and apply the configuration above.
 * Returns 0 on success, negative errno on failure. */
int max30102_init(const struct i2c_dt_spec *i2c, uint8_t led_current);

/* Read and clear the interrupt status registers (releases the INT pin). */
int max30102_clear_interrupts(const struct i2c_dt_spec *i2c);

/* Read every sample currently in the FIFO (up to max).
 * Returns the number of samples read, or negative errno.
 * *overflow is set to the number of samples the chip had to discard
 * because the FIFO was full (0 in normal operation). */
int max30102_read_fifo(const struct i2c_dt_spec *i2c,
		       struct max30102_sample *out, int max, int *overflow);
```

## src/sensor.c
```c
#include "sensor.h"

#include <zephyr/device.h>
#include <zephyr/drivers/gpio.h>
#include <zephyr/drivers/i2c.h>

#include "max30102.h"

#define LED_CURRENT 0x30   /* about 9.6 mA (0.2 mA per step); 0x24 (7.2 mA) gave a weak pulse */

#define MAX_NODE DT_NODELABEL(max30102)
static const struct i2c_dt_spec sensor_i2c = I2C_DT_SPEC_GET(MAX_NODE);
static const struct gpio_dt_spec sensor_int = GPIO_DT_SPEC_GET(MAX_NODE, int_gpios);

/* 512 samples = 5 s of buffering, far more than one window analysis (~12 ms) needs */
K_MSGQ_DEFINE(ir_queue, sizeof(int32_t), 512, 4);
K_SEM_DEFINE(data_ready, 0, 1);

static struct gpio_callback int_cb;
static struct sensor_stats stats;
static volatile int status = -EAGAIN;

int sensor_status(void)
{
	return status;
}

int sensor_get(int32_t *ir, k_timeout_t timeout)
{
	return k_msgq_get(&ir_queue, ir, timeout);
}

void sensor_get_stats(struct sensor_stats *out)
{
	*out = stats;
}

static void sensor_isr(const struct device *dev, struct gpio_callback *cb, uint32_t pins)
{
	k_sem_give(&data_ready);
}

static void sensor_thread(void *a, void *b, void *c)
{
	struct max30102_sample batch[MAX30102_FIFO_DEPTH];

	if (!i2c_is_ready_dt(&sensor_i2c) || !gpio_is_ready_dt(&sensor_int)) {
		status = -ENODEV;
		return;
	}

	/* Keep retrying so a loose wire can be fixed without reflashing */
	while ((status = max30102_init(&sensor_i2c, LED_CURRENT)) != 0) {
		k_msleep(1000);
	}

	gpio_pin_configure_dt(&sensor_int, GPIO_INPUT);
	gpio_init_callback(&int_cb, sensor_isr, BIT(sensor_int.pin));
	gpio_add_callback_dt(&sensor_int, &int_cb);
	gpio_pin_interrupt_configure_dt(&sensor_int, GPIO_INT_EDGE_TO_ACTIVE);

	while (true) {
		/* Interrupt, or a 100 ms safety-net timer (10 samples, FIFO holds 32) */
		if (k_sem_take(&data_ready, K_MSEC(100)) == 0) {
			stats.irq_wakeups++;
		} else {
			stats.timeout_wakeups++;
		}

		if (max30102_clear_interrupts(&sensor_i2c) != 0) {
			stats.i2c_errors++;
		}

		int overflow = 0;
		int n = max30102_read_fifo(&sensor_i2c, batch, ARRAY_SIZE(batch), &overflow);

		if (n < 0) {
			stats.i2c_errors++;
			continue;
		}
		stats.fifo_overflows += overflow;

		for (int i = 0; i < n; i++) {
			int32_t ir = (int32_t)batch[i].ir;

			if (k_msgq_put(&ir_queue, &ir, K_NO_WAIT) != 0) {
				stats.queue_drops++;
			}
		}
	}
}

/* Priority 2: higher than processing (main, priority 7), so acquiring samples
 * always preempts analysing them. Lower number = higher priority. */
K_THREAD_DEFINE(sensor_tid, 2048, sensor_thread, NULL, NULL, NULL, 2, 0, 0);
```

## src/sensor.h
```c
/*
 * Sensor acquisition: a high-priority thread reads the MAX30102 FIFO and
 * queues raw IR samples at 100 Hz for the processing thread.
 */
#ifndef SENSOR_H_
#define SENSOR_H_

#include <stdint.h>
#include <zephyr/kernel.h>

#ifdef __cplusplus
extern "C" {
#endif

struct sensor_stats {
	uint32_t fifo_overflows;   /* samples the chip discarded (FIFO full) */
	uint32_t queue_drops;      /* samples dropped because processing fell behind */
	uint32_t i2c_errors;
	uint32_t irq_wakeups;
	uint32_t timeout_wakeups;
};

/* 0 once the sensor answers and is configured, negative errno before that. */
int sensor_status(void);

/* Wait for the next raw IR sample. Returns 0 on success. */
int sensor_get(int32_t *ir, k_timeout_t timeout);

void sensor_get_stats(struct sensor_stats *out);

#ifdef __cplusplus
}
#endif

#endif /* SENSOR_H_ */
```
