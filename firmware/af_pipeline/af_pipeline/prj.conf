## CMakeLists.txt
```
# F4: full AF pipeline on the board, verified against Python golden data.
cmake_minimum_required(VERSION 3.20.0)

# Always send console output over USB (same as passing -S cdc-acm-console)
set(SNIPPET cdc-acm-console CACHE STRING "")

find_package(Zephyr REQUIRED HINTS $ENV{ZEPHYR_BASE})
project(af_pipeline LANGUAGES C CXX)

target_sources(app PRIVATE
	src/main.cpp
	src/af_dsp.c
)
target_include_directories(app PRIVATE src)
```

## prj.conf
```kconfig
# Kconfig: switches that decide which parts of Zephyr are compiled in.

# --- C++ and the C library TFLite Micro needs ---
CONFIG_CPP=y
CONFIG_STD_CPP17=y
CONFIG_REQUIRES_FULL_LIBC=y

# --- TensorFlow Lite Micro, with Arm's optimized CMSIS-NN kernels ---
CONFIG_TENSORFLOW_LITE_MICRO=y
CONFIG_TENSORFLOW_LITE_MICRO_CMSIS_NN_KERNELS=y

# --- Hardware floating point (the nRF52840's Cortex-M4F has an FPU) ---
CONFIG_FPU=y

# --- Cycle-accurate timing for measuring inference latency ---
CONFIG_TIMING_FUNCTIONS=y

# --- Let printk print floats ---
CONFIG_CBPRINTF_FP_SUPPORT=y

# --- Room for the pipeline's work buffers in main() ---
CONFIG_MAIN_STACK_SIZE=8192
```

## src/main.cpp
```c
/*
 * F4: the full AF screening pipeline on the board, verified against Python.
 *
 * Golden segments (golden_dsp.h, exported from the notebook) contain raw
 * MAX30102-style IR counts: your own recording and a real AF patient from
 * MIMIC. Each segment is streamed sample by sample through the same code the
 * live sensor will use, and every 30 s window is compared with Python:
 * beat count, SQI, features, quality gate and model output.
 */

#include <zephyr/kernel.h>
#include <zephyr/sys/printk.h>
#include <zephyr/timing/timing.h>

#include <math.h>
#include <stdlib.h>

#include <tensorflow/lite/micro/micro_interpreter.h>
#include <tensorflow/lite/micro/micro_mutable_op_resolver.h>
#include <tensorflow/lite/schema/schema_generated.h>

#include "af_dsp.h"
#include "af_model.h"
#include "golden_dsp.h"

namespace {

constexpr size_t kArenaSize = 4 * 1024;
alignas(16) uint8_t tensor_arena[kArenaSize];

tflite::MicroInterpreter *interpreter;
TfLiteTensor *model_in;
TfLiteTensor *model_out;

struct af_pipeline pipeline;

bool model_init()
{
	const tflite::Model *model = tflite::GetModel(af_model);

	if (model->version() != TFLITE_SCHEMA_VERSION) {
		printk("Model schema mismatch\n");
		return false;
	}
	static tflite::MicroMutableOpResolver<4> resolver;

	resolver.AddFullyConnected();
	resolver.AddLogistic();
	resolver.AddSub();
	resolver.AddMul();

	static tflite::MicroInterpreter interp(model, resolver, tensor_arena, kArenaSize);

	if (interp.AllocateTensors() != kTfLiteOk) {
		printk("AllocateTensors failed\n");
		return false;
	}
	interpreter = &interp;
	model_in = interp.input(0);
	model_out = interp.output(0);
	return true;
}

int8_t run_model(const float features[AF_NUM_FEATURES])
{
	const float scale = model_in->params.scale;
	const int zp = model_in->params.zero_point;

	for (int f = 0; f < AF_NUM_FEATURES; f++) {
		int32_t q = static_cast<int32_t>(lroundf(features[f] / scale)) + zp;

		model_in->data.int8[f] = static_cast<int8_t>(q < -128 ? -128 : (q > 127 ? 127 : q));
	}
	interpreter->Invoke();
	return model_out->data.int8[0];
}

const char *class_name(bool gate, int8_t out)
{
	if (!gate) {
		return "unreliable signal";
	}
	return out >= 0 ? "possible AF" : "normal";
}

}  // namespace

int main(void)
{
	k_sleep(K_SECONDS(2));
	printk("\n=== AF pipeline verification on %s ===\n", CONFIG_BOARD_TARGET);

	if (!model_init()) {
		return -1;
	}
	timing_init();
	timing_start();

	while (true) {
		int windows = 0, matched = 0;
		uint64_t worst_ns = 0;
		float worst_sqi = 0.0f, worst_feat = 0.0f;

		for (int s = 0; s < GOLDEN_NUM_SEGMENTS; s++) {
			printk("\n%s (true rhythm: %s)\n", golden_seg_name[s],
			       golden_seg_label[s] ? "AF" : "normal");
			printk(" win beats   SQI     HR  model  board result       python\n");

			af_pipeline_reset(&pipeline);
			int k = 0;

			for (int i = 0; i < GOLDEN_SEG_LEN && k < GOLDEN_WINDOWS_PER_SEG; i++) {
				struct af_window_result r;

				timing_t t0 = timing_counter_get();
				bool done = af_pipeline_push(&pipeline, golden_raw[s][i], &r);
				int8_t out = -128;

				if (done && r.features_valid) {
					out = run_model(r.features);
				}
				timing_t t1 = timing_counter_get();

				if (!done) {
					continue;
				}

				/* The push that completes a window does all the analysis */
				uint64_t ns = timing_cycles_to_ns(timing_cycles_get(&t0, &t1));

				if (ns > worst_ns) {
					worst_ns = ns;
				}

				const struct golden_window *g = &golden_expected[s][k];
				float d_sqi = fabsf(r.sqi - g->sqi);
				float d_feat = 0.0f;

				for (int f = 0; f < AF_NUM_FEATURES; f++) {
					float d = fabsf(r.features[f] - g->features[f]);

					d_feat = d > d_feat ? d : d_feat;
				}
				worst_sqi = d_sqi > worst_sqi ? d_sqi : worst_sqi;
				worst_feat = d_feat > worst_feat ? d_feat : worst_feat;

				bool ok = r.n_beats == g->n_beats && d_sqi < 1e-3f &&
					  r.features_valid == (bool)g->valid &&
					  r.passes_gate == (bool)g->gate &&
					  (!g->valid || (d_feat < 1e-4f && abs(out - g->model_out) <= 1));

				windows++;
				matched += ok;

				printk("  %d   %3d   %.3f %6.1f  %4d   %-17s  %s %s\n", k, r.n_beats,
				       (double)r.sqi, (double)r.heart_rate_bpm, out,
				       class_name(r.passes_gate, out),
				       class_name(g->gate, g->model_out), ok ? "OK" : "MISMATCH");
				k++;
			}
		}

		printk("\nWindows matching Python: %d/%d\n", matched, windows);
		printk("Largest difference: SQI %.2e, features %.2e\n",
		       (double)worst_sqi, (double)worst_feat);
		printk("Time to analyse one 30 s window (DSP + model): %u us\n",
		       (unsigned)(worst_ns / 1000));
		printk("%s\n", matched == windows ? "RESULT: PASS" : "RESULT: FAIL");

		k_sleep(K_SECONDS(15));
	}
	return 0;
}
```

## src/af_dsp.h
```c
/*
 * AF screening signal processing, ported from the Python pipeline.
 *
 * Every step must match the Python code exactly (see CLAUDE.md):
 *   invert -> remove DC (mean of first 1 s) -> causal band-pass 0.5-8 Hz
 *   -> skip 2 s -> 30 s windows -> z-score -> beat detection
 *   -> quality gate (template SQI) -> rhythm features
 *
 * Plain C with no Zephyr dependencies, so it also compiles on a PC for
 * testing against the Python reference.
 */
#ifndef AF_DSP_H_
#define AF_DSP_H_

#include <stdbool.h>
#include <stdint.h>

#ifdef __cplusplus
extern "C" {
#endif

#define AF_FS            100     /* samples per second */
#define AF_DC_SAMPLES    100     /* 1 s used to estimate the DC level */
#define AF_SKIP_SAMPLES  200     /* 2 s skipped while the filter settles */
#define AF_WIN_SAMPLES   3000    /* 30 s analysis window */
#define AF_MAX_PEAKS     1600    /* upper bound on local maxima in one window */
#define AF_NUM_FEATURES  4
#define AF_SQI_THRESHOLD 0.80f

enum af_class {
	AF_CLASS_UNRELIABLE = 0,   /* quality gate rejected the window */
	AF_CLASS_NORMAL = 1,
	AF_CLASS_POSSIBLE_AF = 2,
};

/* Result for one 30 s window (the classification is filled in by the caller,
 * which runs the model). */
struct af_window_result {
	int n_beats;                        /* detected beats in the window */
	float sqi;                          /* template-matching quality, 0..1 */
	bool features_valid;                /* false if too few valid beats */
	float features[AF_NUM_FEATURES];    /* nrmssd, cv, pnn_rel, mad_rel */
	float heart_rate_bpm;
	bool passes_gate;                   /* features valid and sqi >= threshold */
};

/* Streaming pipeline state: feed raw MAX30102 IR counts one at a time. */
struct af_pipeline {
	int32_t dc_buf[AF_DC_SAMPLES];
	int dc_fill;
	bool dc_ready;
	float dc;                           /* DC level of the inverted signal */
	float z[2][2];                      /* filter state, 2 second-order sections */
	int skipped;
	int win_fill;
	float win[AF_WIN_SAMPLES];
};

/* Start a new recording (call when a finger has been placed and has settled). */
void af_pipeline_reset(struct af_pipeline *p);

/* Add one raw IR sample. Returns true when a 30 s window has just been
 * completed and analysed; the result is written to *out. */
bool af_pipeline_push(struct af_pipeline *p, int32_t raw_ir, struct af_window_result *out);

/* Building blocks, exposed for testing. */
int af_find_peaks(const float *x, int n, int *peaks);
float af_template_sqi(const float *w, int n, const int *peaks, int n_peaks);
bool af_rhythm_features(const int *peaks, int n_peaks, float features[AF_NUM_FEATURES],
			float *heart_rate_bpm);
void af_analyse_window(float *w, struct af_window_result *out);

#ifdef __cplusplus
}
#endif

#endif /* AF_DSP_H_ */
```
